## app/boards/shields/nrf52840dk_tester/Kconfig.shield
```kconfig
# Copyright (c) 2025 The ZMK Contributors
# SPDX-License-Identifier: MIT

config SHIELD_NRF52840DK_TESTER
    def_bool $(shields_list_contains,nrf52840dk_tester)
```
